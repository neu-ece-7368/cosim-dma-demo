/dts-v1/;
/plugin/;

/ {
    fragment@0 {
        target-path = "/amba_pl";
        __overlay__ {
          #address-cells = <1>;
          #size-cells = <1>;
            debugdev@48000000 {
                compatible = "generic-uio";
                status = "okay";
                reg = <0x48000000 0x100>;
                interrupt-parent = <&intc>;
                interrupts = <0 29 4>;
            };

            dma@48001000 {
                compatible = "generic-uio";
                status = "okay";
                reg = <0x48001000 0x100>;
                interrupt-parent = <&intc>;
                interrupts = <0 30 4>;
            };
        };
    };
};
